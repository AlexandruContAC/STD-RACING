## prj.conf
```kconfig
CONFIG_CEREBRI_APP_NAME="b3rb"

CONFIG_SYS_CLOCK_TICKS_PER_SEC=10000
CONFIG_TICKLESS_KERNEL=n

CONFIG_CEREBRI_DREAM_SIL=n
CONFIG_CEREBRI_SENSE_UBX_GNSS_MODULE_TYPE_M8=y
CONFIG_CEREBRI_SENSE_UBX_GNSS_BAUD=38400

CONFIG_CEREBRI_B3RB_ESTIMATE=y
CONFIG_CEREBRI_B3RB_FSM=y
CONFIG_CEREBRI_B3RB_MANUAL=y
CONFIG_CEREBRI_B3RB_MIXING=y
CONFIG_CEREBRI_B3RB_POSITION=n
CONFIG_CEREBRI_B3RB_VELOCITY=y
CONFIG_CEREBRI_B3RB_LIGHTING=y
CONFIG_CEREBRI_B3RB_CASADI=y

CONFIG_CEREBRI_ACTUATE_PWM=y
CONFIG_CEREBRI_ACTUATE_LED_ARRAY=y
CONFIG_CEREBRI_ACTUATE_SOUND=y

CONFIG_NET_BUF_RX_COUNT=24
CONFIG_NET_PKT_RX_COUNT=24

CONFIG_CEREBRI_SENSE_POWER=n
CONFIG_CEREBRI_SENSE_SAFETY=n
CONFIG_CEREBRI_SENSE_IMU=y
CONFIG_CEREBRI_SENSE_MAG=y
CONFIG_CEREBRI_SENSE_WHEEL_ODOMETRY=y
CONFIG_CEREBRI_SENSE_UBX_GNSS=y

CONFIG_CEREBRI_SYNAPSE_ETH_RX=y
CONFIG_CEREBRI_SYNAPSE_ETH_TX=y
CONFIG_CEREBRI_SYNAPSE_ETHERNET=n

CONFIG_CEREBRI_SYNAPSE_TOPIC=y
CONFIG_CEREBRI_CORE_COMMON=y
CONFIG_CEREBRI_CORE_COMMON_BOOT_BANNER=y
CONFIG_CEREBRI_SYNAPSE_ZROS=y

CONFIG_SHELL_STACK_SIZE=10240
CONFIG_INIT_STACKS=y

CONFIG_LOG=y
CONFIG_LOG_CMDS=y
CONFIG_LOG_MODE_DEFERRED=y

CONFIG_ASSERT=y
CONFIG_TEST=y
CONFIG_CBPRINTF_FP_SUPPORT=y

# modules
CONFIG_SYNAPSE_PROTOBUF=y
CONFIG_SYNAPSE_TINYFRAME=y
CONFIG_NANOPB=y
CONFIG_UBXLIB=y

# Debug
CONFIG_CEREBRI_SENSE_WHEEL_ODOMETRY_LOG_LEVEL_DBG=n
CONFIG_CEREBRI_SENSE_IMU_LOG_LEVEL_DBG=n
CONFIG_CEREBRI_SENSE_SAFETY_LOG_LEVEL_DBG=n

# General config
CONFIG_POSIX_API=y
CONFIG_NEWLIB_LIBC=y
CONFIG_MAIN_THREAD_PRIORITY=5
CONFIG_SYSTEM_WORKQUEUE_PRIORITY=-2
CONFIG_SYS_CLOCK_TICKS_PER_SEC=10000
# Networking config
CONFIG_NET_SHELL=y
CONFIG_NETWORKING=y
CONFIG_NET_IPV4=y
CONFIG_NET_IPV6=n
CONFIG_NET_TCP=y
CONFIG_NET_SOCKETS=y

# Network address config
CONFIG_NET_CONFIG_SETTINGS=y
CONFIG_NET_STATISTICS=y
CONFIG_NET_MGMT_EVENT_INFO=y
CONFIG_NET_MGMT_EVENT_MONITOR=y
CONFIG_NET_BUF_POOL_USAGE=y
CONFIG_NET_DEBUG_NET_PKT_ALLOC=y
CONFIG_NET_CONFIG_NEED_IPV4=y
CONFIG_NET_CONFIG_MY_IPV4_ADDR="192.0.2.1"
CONFIG_NET_CONFIG_PEER_IPV4_ADDR="192.0.2.2"

# STATS
CONFIG_THREAD_RUNTIME_STATS=y
CONFIG_SCHED_THREAD_USAGE=y
CONFIG_SCHED_THREAD_USAGE_ANALYSIS=y
CONFIG_SCHED_THREAD_USAGE_ALL=y
CONFIG_SCHED_THREAD_USAGE_AUTO_ENABLE=y
```

## boards/mr_canhubk3.conf
```kconfig
CONFIG_ENTROPY_GENERATOR=y
CONFIG_TEST_RANDOM_GENERATOR=y

CONFIG_CEREBRI_ACTUATE_PWM_NUMBER=2
CONFIG_LED_STRIP=y
CONFIG_APA102_STRIP=y

CONFIG_ETH_NXP_S32_RX_RING_LEN=16

# steering

CONFIG_CEREBRI_ACTUATE_PWM_INDEX_0=0
CONFIG_CEREBRI_ACTUATE_PWM_PULSE_MIN_0=770
CONFIG_CEREBRI_ACTUATE_PWM_PULSE_CENTER_0=1000
CONFIG_CEREBRI_ACTUATE_PWM_PULSE_MAX_0=1330

# throttle
CONFIG_CEREBRI_ACTUATE_PWM_INDEX_1=0
CONFIG_CEREBRI_ACTUATE_PWM_USE_NANO_SECONDS_1=y
CONFIG_CEREBRI_ACTUATE_PWM_PULSE_MIN_1=0
CONFIG_CEREBRI_ACTUATE_PWM_PULSE_MAX_1=50000
CONFIG_CEREBRI_ACTUATE_PWM_PULSE_CENTER_1=25000
CONFIG_CEREBRI_ACTUATE_PWM_LINEAR_1=y
CONFIG_CEREBRI_ACTUATE_PWM_LINEAR_M_1=900
CONFIG_CEREBRI_ACTUATE_PWM_LINEAR_M_DIV_1=1
CONFIG_CEREBRI_ACTUATE_PWM_LINEAR_B_1=0
CONFIG_CEREBRI_ACTUATE_PWM_LINEAR_B_DIV_1=1

CONFIG_PWM=y

CONFIG_CAN=y
CONFIG_CAN_MAX_FILTER=5
CONFIG_CAN_SHELL=y

CONFIG_NET_DRIVERS=y
CONFIG_NET_CANBUS=y

CONFIG_NET_SOCKETS_CAN=y
CONFIG_NET_DEFAULT_IF_CANBUS_RAW=y

CONFIG_CAN_LOG_LEVEL_DBG=n
CONFIG_CAN_FD_MODE=y
CONFIG_SHELL_ARGC_MAX=72
CONFIG_I2C=y
CONFIG_SENSOR=y
CONFIG_HEAP_MEM_POOL_SIZE=16384

# Debugging
CONFIG_DEBUG_THREAD_INFO=y

# Logging
#CONFIG_LOG_BACKEND_NET=n
#CONFIG_LOG_BACKEND_NET_SERVER="192.0.2.2"
```

## src/fsm.c
```c
/*
 * Copyright CogniPilot Foundation 2023
 * SPDX-License-Identifier: Apache-2.0
 */

#include <stdio.h>
#include <zephyr/kernel.h>
#include <zephyr/logging/log.h>

#include <zros/private/zros_node_struct.h>
#include <zros/private/zros_pub_struct.h>
#include <zros/private/zros_sub_struct.h>
#include <zros/zros_node.h>
#include <zros/zros_pub.h>
#include <zros/zros_sub.h>

#include <synapse_topic_list.h>

#define MY_STACK_SIZE 3072
#define MY_PRIORITY 4
#define STATE_ANY -1

LOG_MODULE_REGISTER(b3rb_fsm, CONFIG_CEREBRI_B3RB_LOG_LEVEL);

static void transition(
    void* state,
    bool request,
    const char* request_name,
    int pre,
    uint8_t post,
    char* buf,
    size_t n,
    int* request_seq,
    bool* request_rejected,
    size_t n_guards,
    ...)
{
    uint8_t* state_int = (uint8_t*)state;

    // not requested
    if (!request) {
        return;
    }

    // null transition
    if (*state_int == post) {
        return;
    }

    // LOG_INF("%s pre: %d, post: %d, state: %d", request_name, pre, post, *state_int);
    // pre state required and not matched
    if (pre >= 0 && *state_int != pre) {
        return;
    }

    // new valid request
    (*request_seq)++;

    // check guards
    va_list ap;
    va_start(ap, n_guards);
    for (size_t i = 0; i < n_guards; i++) {
        int guard = va_arg(ap, int);
        const char* guard_txt = va_arg(ap, const char*);
        if (guard) {
            snprintf(buf, n, "deny %s: %s", request_name, guard_txt);
            LOG_WRN("%s", buf);
            *request_rejected = true;
            return;
        }
    }
    va_end(ap);
    snprintf(buf, n, "accept %s", request_name);
    LOG_INF("%s", buf);
    *state_int = post;
    *request_rejected = false;
    return;
}

typedef struct status_input_s {
    bool request_arm;
    bool request_disarm;
    bool request_manual;
    bool request_auto;
    bool request_cmd_vel;
    bool request_calibration;
    bool safe;
    bool mode_set;
    bool fuel_low;
    bool fuel_critical;
} status_input_t;

typedef struct _context {
    struct zros_node node;
    synapse_msgs_Joy joy;
    synapse_msgs_BatteryState battery_state;
    synapse_msgs_Safety safety;
    synapse_msgs_Status status;
    status_input_t status_input;
    struct zros_sub sub_joy, sub_battery_state, sub_safety;
    struct zros_pub pub_status;
} context;

static context g_ctx = {
    .node = {},
    .joy = synapse_msgs_Joy_init_default,
    .battery_state = synapse_msgs_BatteryState_init_default,
    .safety = synapse_msgs_Safety_init_default,
    .status = {
        .has_header = true,
        .header = {
            .frame_id = "base_link",
            .has_stamp = true,
            .seq = 0,
            .stamp = synapse_msgs_Time_init_default,
        },
        .arming = synapse_msgs_Status_Arming_ARMING_DISARMED,
        .fuel = synapse_msgs_Status_Fuel_FUEL_UNKNOWN,
        .fuel_percentage = 0,
        .joy = synapse_msgs_Status_Joy_JOY_UNKNOWN,
        .mode = synapse_msgs_Status_Mode_MODE_UNKNOWN,
        .power = 0.0,
        .safety = synapse_msgs_Status_Safety_SAFETY_UNKNOWN,
        .status_message = "",
    },
    .sub_joy = {},
    .sub_battery_state = {},
    .sub_safety = {},
    .pub_status = {},
};

static void b3rb_fsm_init(context* ctx)
{
    zros_node_init(&ctx->node, "b3rb_fsm");
    zros_sub_init(&ctx->sub_joy, &ctx->node, &topic_joy, &ctx->joy, 10);
    zros_sub_init(&ctx->sub_battery_state, &ctx->node,
        &topic_battery_state, &ctx->battery_state, 10);
    zros_sub_init(&ctx->sub_safety, &ctx->node, &topic_safety, &ctx->safety, 10);
    zros_pub_init(&ctx->pub_status, &ctx->node, &topic_status, &ctx->status);
}

static void fsm_compute_input(status_input_t* input, const context* ctx)
{
    input->request_arm = ctx->joy.buttons[JOY_BUTTON_ARM] == 1;
    input->request_disarm = ctx->joy.buttons[JOY_BUTTON_DISARM] == 1;
    input->request_manual = ctx->joy.buttons[JOY_BUTTON_MANUAL] == 1;
    input->request_auto = ctx->joy.buttons[JOY_BUTTON_AUTO] == 1;
    input->request_cmd_vel = ctx->joy.buttons[JOY_BUTTON_CMD_VEL] == 1;
    input->request_calibration = ctx->joy.buttons[JOY_BUTTON_CALIBRATION] == 1;
    input->mode_set = ctx->status.mode != synapse_msgs_Status_Mode_MODE_UNKNOWN;
#ifdef CONFIG_CEREBRI_SENSE_SAFETY
    input->safe = ctx->safety.status == synapse_msgs_Safety_Status_SAFETY_SAFE || ctx->safety.status == synapse_msgs_Safety_Status_SAFETY_UNKNOWN;
#else
    input->safe = false;
#endif

#ifdef CONFIG_CEREBRI_SENSE_POWER
    input->fuel_low = ctx->battery_state.voltage < CONFIG_CEREBRI_B3RB_BATTERY_LOW_MILLIVOLT / 1000.0;
    input->fuel_critical = ctx->battery_state.voltage < CONFIG_CEREBRI_B3RB_BATTERY_MIN_MILLIVOLT / 1000.0;
#else
    input->fuel_low = false;
    input->fuel_critical = false;
#endif
}

static void fsm_update(synapse_msgs_Status* status, const status_input_t* input)
{
    // arm transition
    transition(
        &status->arming, // state
        input->request_arm, // request
        "request arm", // label
        synapse_msgs_Status_Arming_ARMING_DISARMED, // pre
        synapse_msgs_Status_Arming_ARMING_ARMED, // post
        status->status_message, sizeof(status->status_message), // status
        &status->request_seq, &status->request_rejected, // request
        // guards
        5,
        status->mode == synapse_msgs_Status_Mode_MODE_UNKNOWN, "mode not set",
        status->mode == synapse_msgs_Status_Mode_MODE_CALIBRATION, "mode calibration",
        input->safe, "safety on",
        input->fuel_critical, "fuel_critical",
        input->fuel_low, "fuel_low");

    // disarm transitions
    transition(
        &status->arming, // state
        input->request_disarm, // request
        "request disarm", // label
        synapse_msgs_Status_Arming_ARMING_ARMED, // pre
        synapse_msgs_Status_Arming_ARMING_DISARMED, // post
        status->status_message, sizeof(status->status_message), // status
        &status->request_seq, &status->request_rejected, // request
        0); // guards

    // disarm transitions
    transition(
        &status->arming, // state
        input->fuel_critical, // request
        "disarm fuel critical", // label
        synapse_msgs_Status_Arming_ARMING_ARMED, // pre
        synapse_msgs_Status_Arming_ARMING_DISARMED, // post
        status->status_message, sizeof(status->status_message), // status
        &status->request_seq, &status->request_rejected, // request
        0); // guards

    transition(
        &status->arming, // state
        input->safe, // request
        "disarm safety engaged", // label
        synapse_msgs_Status_Arming_ARMING_ARMED, // pre
        synapse_msgs_Status_Arming_ARMING_DISARMED, // post
        status->status_message, sizeof(status->status_message), // status
        &status->request_seq, &status->request_rejected, // request
        0); // guards

    // mode transitions
    transition(
        &status->mode, // state
        input->request_manual, // request
        "request mode manual", // label
        STATE_ANY, // pre
        synapse_msgs_Status_Mode_MODE_MANUAL, // post
        status->status_message, sizeof(status->status_message), // status
        &status->request_seq, &status->request_rejected, // request
        0); // guards

    transition(
        &status->mode, // state
        input->request_cmd_vel, // request
        "request mode cmd_vel", // label
        STATE_ANY, // pre
        synapse_msgs_Status_Mode_MODE_CMD_VEL, // post
        status->status_message, sizeof(status->status_message), // status
        &status->request_seq, &status->request_rejected, // request
        0); // guards
        
    transition(
        &status->mode, // state
        input->request_auto, // request
        "request mode auto", // label
        STATE_ANY, // pre
        synapse_msgs_Status_Mode_MODE_AUTO, // post
        status->status_message, sizeof(status->status_message), // status
        &status->request_seq, &status->request_rejected, // request
        0); // guards

    transition(
        &status->mode, // state
        input->request_calibration, // request
        "request mode calibration", // label
        STATE_ANY, // pre
        synapse_msgs_Status_Mode_MODE_CALIBRATION, // post
        status->status_message, sizeof(status->status_message), // status
        &status->request_seq, &status->request_rejected, // request
        // guards
        1,
        status->arming == synapse_msgs_Status_Arming_ARMING_ARMED, "disarm required");

    // set timestamp
    stamp_header(&status->header, k_uptime_ticks());
    status->header.seq++;
}

static void status_add_extra_info(synapse_msgs_Status* status, status_input_t* input, const context* ctx)
{
    if (input->fuel_critical) {
        status->fuel = synapse_msgs_Status_Fuel_FUEL_CRITICAL;
    } else if (input->fuel_low) {
        status->fuel = synapse_msgs_Status_Fuel_FUEL_LOW;
    } else {
        status->fuel = synapse_msgs_Status_Fuel_FUEL_NOMINAL;
    }
    float bat_max = CONFIG_CEREBRI_B3RB_BATTERY_MAX_MILLIVOLT / 1000.0;
    float bat_min = CONFIG_CEREBRI_B3RB_BATTERY_MIN_MILLIVOLT / 1000.0;
    status->fuel_percentage = 100 * (ctx->battery_state.voltage - bat_min) / (bat_max - bat_min);
    status->power = ctx->battery_state.voltage * ctx->battery_state.current;
#ifdef CONFIG_CEREBRI_SENSE_SAFETY
    if (ctx->safety.status == synapse_msgs_Safety_Status_SAFETY_SAFE) {
        status->safety = synapse_msgs_Status_Safety_SAFETY_SAFE;
    } else if (ctx->safety.status == synapse_msgs_Safety_Status_SAFETY_UNSAFE) {
        status->safety = synapse_msgs_Status_Safety_SAFETY_UNSAFE;
    } else if (ctx->safety.status == synapse_msgs_Safety_Status_SAFETY_UNKNOWN) {
        status->safety = synapse_msgs_Status_Safety_SAFETY_UNKNOWN;
    }
#else
    status->safety = synapse_msgs_Status_Safety_SAFETY_UNSAFE;
#endif
}

static void b3rb_fsm_entry_point(void* p0, void* p1, void* p2)
{
    LOG_INF("initializing b3rb_fsm");
    context* ctx = p0;
    ARG_UNUSED(p1);
    ARG_UNUSED(p2);

    b3rb_fsm_init(ctx);

// AUTO-ARM: wait for system to stabilize, then arm in AUTO mode (Pixy line-following)
    LOG_WRN("auto-arm: waiting 3 seconds before arming...");
    k_sleep(K_MSEC(3000));
    ctx->status.mode = synapse_msgs_Status_Mode_MODE_AUTO;
    ctx->status.arming = synapse_msgs_Status_Arming_ARMING_ARMED;
    LOG_WRN("auto-arm: ARMED in AUTO mode (Pixy line-following)");
    zros_pub_update(&ctx->pub_status);

    struct k_poll_event events[] = {
        *zros_sub_get_event(&ctx->sub_joy),
        *zros_sub_get_event(&ctx->sub_battery_state),
    };

    int64_t joy_last_ticks = k_uptime_ticks();
    int64_t joy_loss_ticks = 1.0 * CONFIG_SYS_CLOCK_TICKS_PER_SEC;

    while (true) {

        // current ticks
        int64_t now_ticks = k_uptime_ticks();

        // wait for input event, publish at 1 Hz regardless
        int rc = 0;
        rc = k_poll(events, ARRAY_SIZE(events), K_MSEC(1000));
        if (rc != 0) {
            LOG_DBG("fsm joy/battery polling timeout");
        }

        if (zros_sub_update_available(&ctx->sub_battery_state)) {
            zros_sub_update(&ctx->sub_battery_state);
        }

        if (zros_sub_update_available(&ctx->sub_safety)) {
            zros_sub_update(&ctx->sub_safety);
        }

        if (zros_sub_update_available(&ctx->sub_joy)) {
            zros_sub_update(&ctx->sub_joy);
            if (ctx->status.joy == synapse_msgs_Status_Joy_JOY_LOSS) {
                LOG_WRN("joy regained");
            }
            joy_last_ticks = now_ticks;
            ctx->status.joy = synapse_msgs_Status_Joy_JOY_NOMINAL;
        }

        // check for joy loss
        if (ctx->status.joy != synapse_msgs_Status_Joy_JOY_LOSS
            && now_ticks - joy_last_ticks > joy_loss_ticks) {
            LOG_WRN("joy loss");
            ctx->status.joy = synapse_msgs_Status_Joy_JOY_LOSS;
        }

        // perform processing
        fsm_compute_input(&ctx->status_input, ctx);
        fsm_update(&ctx->status, &ctx->status_input);
        status_add_extra_info(&ctx->status, &ctx->status_input, ctx);
        zros_pub_update(&ctx->pub_status);
    }
}

K_THREAD_DEFINE(b3rb_fsm, MY_STACK_SIZE,
    b3rb_fsm_entry_point, &g_ctx, NULL, NULL,
    MY_PRIORITY, 0, 1000);

/* vi: ts=4 sw=4 et */
```

## src/manual.c
```c
/*
 * Copyright CogniPilot Foundation 2023
 * SPDX-License-Identifier: Apache-2.0
 */

#include <zephyr/kernel.h>
#include <zephyr/logging/log.h>

#include <zros/private/zros_node_struct.h>
#include <zros/private/zros_pub_struct.h>
#include <zros/private/zros_sub_struct.h>
#include <zros/zros_node.h>
#include <zros/zros_pub.h>
#include <zros/zros_sub.h>

#include <synapse_topic_list.h>

#include "mixing.h"

#define MY_STACK_SIZE 1024
#define MY_PRIORITY 4

LOG_MODULE_REGISTER(b3rb_manual, CONFIG_CEREBRI_B3RB_LOG_LEVEL);

typedef struct _context {
    struct zros_node node;
    synapse_msgs_Joy joy;
    synapse_msgs_Actuators actuators_manual;
    struct zros_sub sub_joy;
    struct zros_pub pub_actuators_manual;
    const double wheel_radius;
    const double max_turn_angle;
    const double max_velocity;
} context;

static context g_ctx = {
    .node = {},
    .joy = synapse_msgs_Joy_init_default,
    .actuators_manual = synapse_msgs_Actuators_init_default,
    .sub_joy = {},
    .pub_actuators_manual = {},
    .wheel_radius = CONFIG_CEREBRI_B3RB_WHEEL_RADIUS_MM / 1000.0,
    .max_turn_angle = CONFIG_CEREBRI_B3RB_MAX_TURN_ANGLE_MRAD / 1000.0,
    .max_velocity = CONFIG_CEREBRI_B3RB_MAX_VELOCITY_MM_S / 1000.0,
};

static void init(context* ctx)
{
    zros_node_init(&ctx->node, "b3rb_manual");
    zros_sub_init(&ctx->sub_joy, &ctx->node, &topic_joy, &ctx->joy, 10);
    zros_pub_init(&ctx->pub_actuators_manual, &ctx->node,
        &topic_actuators_manual, &ctx->actuators_manual);
}

static void b3rb_manual_entry_point(void* p0, void* p1, void* p2)
{
    LOG_INF("init");
    context* ctx = p0;
    ARG_UNUSED(p1);
    ARG_UNUSED(p2);

    init(ctx);

    struct k_poll_event events[] = {
        *zros_sub_get_event(&ctx->sub_joy),
    };

    while (true) {
        // wait for joystick input event, publish at 1 Hz regardless
        int rc = 0;
        rc = k_poll(events, ARRAY_SIZE(events), K_MSEC(10));
        if (rc != 0) {
            LOG_DBG("manual not receiving joy");
        }

        if (zros_sub_update_available(&ctx->sub_joy)) {
            zros_sub_update(&ctx->sub_joy);
        }

        // compute turn_angle, and angular velocity from joystick
        ///double turn_angle = ctx->max_turn_angle * ctx->joy.axes[JOY_AXES_ROLL];
        // to avoid confusion direction commands will be between -1 and 1 (relative) to straight which is 0
        double turn_angle = ctx->joy.axes[JOY_AXES_ROLL];
        ///double omega_fwd = ctx->max_velocity * ctx->joy.axes[JOY_AXES_THRUST] / ctx->wheel_radius;
        // to avoid confusion lets consider relative velocity to max phisically possible velocity 1 max forward, 0 stop, -1 max backward
        double omega_fwd = ctx->joy.axes[JOY_AXES_THRUST];
        static double steer_ref_f = 0, speed_ref_f = 0;
        static uint64_t last_ticks;  static bool do_init_static = true; if(do_init_static) { do_init_static=false; last_ticks = k_uptime_ticks();}
    
        filter_refs(omega_fwd, turn_angle, &speed_ref_f, &steer_ref_f, &last_ticks);
        //LOG_ERR("man_dt_ms %d", 
        b3rb_set_actuators(&ctx->actuators_manual, steer_ref_f, speed_ref_f);

        zros_pub_update(&ctx->pub_actuators_manual);
    }
}

K_THREAD_DEFINE(b3rb_manual, MY_STACK_SIZE,
    b3rb_manual_entry_point, (void*)&g_ctx, NULL, NULL,
    MY_PRIORITY, 0, 1000);

/* vi: ts=4 sw=4 et */
```

## src/mixing.c
```c
/*
 * Copyright CogniPilot Foundation 2023
 * SPDX-License-Identifier: Apache-2.0
 */

#include "mixing.h"
#include <zephyr/kernel.h>

static uint32_t elapsed_ms(uint64_t *start_ticks) {
     uint64_t current_ticks = k_uptime_ticks();
     uint64_t ticks = k_uptime_ticks() - *start_ticks;
     
     if(ticks>0x7fffffffffffffff) ticks += 0xffffffffffffffff;
     uint32_t ms = k_ticks_to_ms_ceil32(ticks);
     if(ms>0) {
        *start_ticks = current_ticks;
     }
     return ms;
}
static void filter_ref(double ref, double *filt, uint32_t dt, double min, double max, double a_max, double b_max) {
    double f = *filt;
    double df = ref - f;
    if(df>0 && f >= 0) {
        double Df = a_max * dt * 0.001;
        if(df>Df) {
            f += Df;
        } else {
            f = ref;
        }
    } else if (df<0 && f >= 0) {
        double Df = -b_max * dt * 0.001;
        if(df<Df) {
            f += Df;
        } else {
            f = ref;
        }
    } else if (df>0 && f <= 0) {
        double Df = b_max * dt * 0.001;
        if(df>Df) {
            f += Df;
        } else {
            f = ref;
        }
    } else if (df<0 && f <= 0) {
        double Df = -a_max * dt * 0.001;
        if(df<Df) {
            f += Df;
        } else {
            f = ref;
        }
    } else {
        //WHAT???
    }
    if(f<min) *filt = min;
    else if(f>max) *filt = max;
    else *filt = f;
}

uint32_t filter_refs(double speed_ref, double steer_ref, double *speed_ref_f, double *steer_ref_f, uint64_t *last_ticks) {
    uint32_t dt_ms = elapsed_ms(last_ticks);

    if(dt_ms>0) {
        filter_ref(speed_ref, speed_ref_f, dt_ms, -1, 1, 2, 4);
        filter_ref(steer_ref, steer_ref_f, dt_ms, -1.2, 1.2, 5, 5);
    }
    return dt_ms;
}

void b3rb_set_actuators(synapse_msgs_Actuators* msg, double steer_ref, double speed_ref)
{
    msg->has_header = true;
    stamp_header(&msg->header, k_uptime_ticks());
    msg->header.seq++;
    strncpy(msg->header.frame_id, "odom", sizeof(msg->header.frame_id) - 1);

    msg->position_count = 0;//1; originally was 1... why? it is hard to calibrate servo center, min, max values in position mode...
    msg->velocity_count = 1;
    msg->normalized_count = 1;//2; originally was 2... why? expected 0...
    //msg->position[0] = turn_angle; //why did they user position mode when it is so difficult to calibrate?
    msg->normalized[0] = steer_ref; //better use normalized mode, hence the setting of 1 for normalized count
    msg->velocity[0] = speed_ref;
}

/* vi: ts=4 sw=4 et */
```

## src/mixing.h
```c
/*
 * Copyright CogniPilot Foundation 2023
 * SPDX-License-Identifier: Apache-2.0
 */

#ifndef CEREBRI_B3RB_MIXING_H
#define CEREBRI_B3RB_MIXING_H

#include <synapse_topic_list.h>
uint32_t filter_refs(double speed_ref, double steer_ref,double *speed_ref_f, double *steer_ref_f, uint64_t *last_ticks);
void b3rb_set_actuators(synapse_msgs_Actuators* msg, double turn_angle, double omega_fwd);

#endif // CEREBRI_B3RB_MIXING_H
/* vi: ts=4 sw=4 et */
```

## src/velocity.c
```c
/*
 * Copyright CogniPilot Foundation 2023
 * SPDX-License-Identifier: Apache-2.0
 */

#include "casadi/gen/b3rb.h"

/* Local math helpers to avoid linking libm */
static inline double my_fabs(double x) { return x < 0.0 ? -x : x; }
static double my_sqrt(double x) {
  if (x <= 0.0) return 0.0;
  double guess = x;
  for (int i = 0; i < 20; i++) {
    guess = 0.5 * (guess + x / guess);
  }
  return guess;
}

#include <stdio.h>
#include <zephyr/kernel.h>
#include <zephyr/logging/log.h>

#include <zros/private/zros_node_struct.h>
#include <zros/private/zros_pub_struct.h>
#include <zros/private/zros_sub_struct.h>
#include <zros/zros_node.h>
#include <zros/zros_pub.h>
#include <zros/zros_sub.h>

#include <synapse_topic_list.h>
#include <cerebri/core/casadi.h>

#include "mixing.h"

#define MY_STACK_SIZE 4096
#define MY_PRIORITY 4

LOG_MODULE_REGISTER(b3rb_velocity, CONFIG_CEREBRI_B3RB_LOG_LEVEL);

/* ── Lap detection state machine ──────────────────────────────────────── */
typedef enum {
    STATE_NORMAL,
    STATE_LAP_STARTED,
    STATE_LAP_DONE
} challenge_state_t;

static double g_start_x = 0.0;
static double g_start_y = 0.0;
static bool g_initial_position_set = false;

typedef struct _context {
  struct zros_node node;
  synapse_msgs_Twist cmd_vel;
  synapse_msgs_Status status;
  synapse_msgs_Actuators actuators;
  synapse_msgs_Actuators actuators_manual;
  synapse_msgs_PixyVector pixy_vector;
  synapse_msgs_Odometry odom;
  struct zros_sub sub_status, sub_cmd_vel, sub_actuators_manual,
      sub_pixy_vector, sub_odom;
  struct zros_pub pub_actuators;
  const double wheel_radius;
  const double wheel_base;
  challenge_state_t state;
} context;

static context g_ctx = {
    .node = {},
    .cmd_vel = synapse_msgs_Twist_init_default,
    .status = synapse_msgs_Status_init_default,
    .actuators = synapse_msgs_Actuators_init_default,
    .actuators_manual = synapse_msgs_Actuators_init_default,
    .pixy_vector = synapse_msgs_PixyVector_init_default,
    .odom = synapse_msgs_Odometry_init_default,
    .sub_status = {},
    .sub_cmd_vel = {},
    .sub_actuators_manual = {},
    .sub_odom = {},
    .pub_actuators = {},
    .wheel_radius = CONFIG_CEREBRI_B3RB_WHEEL_RADIUS_MM / 1000.0,
    .wheel_base = CONFIG_CEREBRI_B3RB_WHEEL_BASE_MM / 1000.0,
    .state = STATE_NORMAL,
};

static void update_state(context *ctx) {
  double x = ctx->odom.pose.pose.position.x;
  double y = ctx->odom.pose.pose.position.y;

  if (!g_initial_position_set) {
    /* Wait until the car is actually driving (main.py sending speed) */
    if (my_fabs(ctx->cmd_vel.linear.x) < 0.1) {
      return;
    }
    g_start_x = x;
    g_start_y = y;
    g_initial_position_set = true;
    //LOG_INF("Start position captured: x=%.2f y=%.2f", g_start_x, g_start_y);
  }

  double dx = x - g_start_x;
  double dy = y - g_start_y;
  double dist = my_sqrt(dx * dx + dy * dy);


  switch (ctx->state) {
  case STATE_NORMAL:
    if (dist > 0.5) {
      ctx->state = STATE_LAP_STARTED;
      //LOG_INF("Lap started (dist=%.2f)", dist);
    }
    break;
  case STATE_LAP_STARTED:
    if (dist < 0.1) {
      ctx->state = STATE_LAP_DONE;
      //LOG_INF("Lap done (dist=%.2f) — slowing to 0.2", dist);
    }
    break;
  case STATE_LAP_DONE:
    break;
  }
}

static void init_b3rb_vel(context *ctx) {
  LOG_DBG("init vel");
  zros_node_init(&ctx->node, "b3rb_velocity");
  zros_sub_init(&ctx->sub_cmd_vel, &ctx->node, &topic_cmd_vel, &ctx->cmd_vel,
                10);
  zros_sub_init(&ctx->sub_status, &ctx->node, &topic_status, &ctx->status, 10);
  zros_sub_init(&ctx->sub_actuators_manual, &ctx->node, &topic_actuators_manual,
                &ctx->actuators_manual, 10);
  zros_sub_init(&ctx->sub_pixy_vector, &ctx->node, &topic_pixy_vector,
                &ctx->pixy_vector, 10);
  zros_sub_init(&ctx->sub_odom, &ctx->node, &topic_estimator_odometry,
                &ctx->odom, 10);
  zros_pub_init(&ctx->pub_actuators, &ctx->node, &topic_actuators,
                &ctx->actuators);
}

// computes rc_input from V, omega
static void update_cmd_vel(context *ctx) {
  double V = ctx->cmd_vel.linear.x;
  double omega = ctx->cmd_vel.angular.z;

  // b3rb_set_actuators(&ctx->actuators, omega, V);
  static double steer_ref_f = 0, speed_ref_f = 0;
  static uint64_t last_ticks;
  static bool do_init_static = true;
  if (do_init_static) {
    do_init_static = false;
    last_ticks = k_uptime_ticks();
  }
  // LOG_ERR("auto_dt_ms %d",
  filter_refs(V, omega, &speed_ref_f, &steer_ref_f, &last_ticks);
  b3rb_set_actuators(&ctx->actuators, steer_ref_f, speed_ref_f);
}
static void follow_line(context *ctx) {
  // copiere valori steer si speed din cmd_vel, primite de la nav q plus
  double steer = ctx->cmd_vel.angular.z;
  double speed = ctx->cmd_vel.linear.x;

  update_state(ctx);

  if (ctx->state == STATE_LAP_DONE) {
    if (my_fabs(speed) < 0.01) {
      // LIDAR IS ACTIVE! Leave speed exactly at 0.0
      speed = 0.0; 
    } else {
      // Normal driving. Cap speed to 0.2 because lap is done
      speed = 0.2;
    }
  }

  printf("steer %f speed %f state %d\n", steer, speed, ctx->state);

  static double steer_ref_f = 0, speed_ref_f = 0;
  static uint64_t last_ticks;
  static bool do_init_static = true;
  if (do_init_static) {
    do_init_static = false;
    last_ticks = k_uptime_ticks();
  }
  LOG_INF("steer %f speed %f state %d\n", steer, speed, ctx->state);

  filter_refs(speed, steer, &speed_ref_f, &steer_ref_f, &last_ticks);
  b3rb_set_actuators(&ctx->actuators, steer_ref_f, speed_ref_f);
}

static void stop(context *ctx) { b3rb_set_actuators(&ctx->actuators, 0, 0); }

static void b3rb_velocity_entry_point(void *p0, void *p1, void *p2) {
  LOG_INF("init");
  context *ctx = p0;
  ARG_UNUSED(p1);
  ARG_UNUSED(p2);

  init_b3rb_vel(ctx);

  synapse_msgs_Status_Mode prev_mode = synapse_msgs_Status_Mode_MODE_UNKNOWN;

  static int64_t cmd_vel_last_ticks = 0;
  static bool cmd_vel_ever_received = false;

  while (true) {
    synapse_msgs_Status_Mode mode = ctx->status.mode;

    int rc = 0;
    if (mode == synapse_msgs_Status_Mode_MODE_MANUAL) {
      struct k_poll_event events[] = {
          *zros_sub_get_event(&ctx->sub_actuators_manual),
      };
      rc = k_poll(events, ARRAY_SIZE(events), K_MSEC(1000));
      if (rc != 0) {
        LOG_DBG("not receiving manual actuators");
      }
    } else if (mode == synapse_msgs_Status_Mode_MODE_CMD_VEL) {
      struct k_poll_event events[] = {
          *zros_sub_get_event(&ctx->sub_cmd_vel),
      };
      rc = k_poll(events, ARRAY_SIZE(events), K_MSEC(1000));
      if (rc != 0) {
        LOG_DBG("not receiving cmd_vel");
      }
    } else { /// Cazul auto NE INTERESEAZA
      struct k_poll_event events[] = {
          *zros_sub_get_event(&ctx->sub_cmd_vel), // Modificat: ascultam cmd_vel
                                                  // in loc de pixy_vector
      };
      rc = k_poll(events, ARRAY_SIZE(events), K_MSEC(1000));
      if (rc != 0) {
        LOG_DBG("not receiving cmd_vel in auto mode");
      }
    }

    if (zros_sub_update_available(&ctx->sub_status)) {
      zros_sub_update(&ctx->sub_status);
    }

    if (zros_sub_update_available(&ctx->sub_cmd_vel)) {
      zros_sub_update(&ctx->sub_cmd_vel);
      cmd_vel_last_ticks = k_uptime_ticks();
      cmd_vel_ever_received = true;
    }

    /* Reset lap state when cmd_vel goes stale (main.py was closed) */
    if (cmd_vel_ever_received) {
      int64_t now = k_uptime_ticks();
      if ((now - cmd_vel_last_ticks) > 2 * CONFIG_SYS_CLOCK_TICKS_PER_SEC) {
        g_initial_position_set = false;
        ctx->state = STATE_NORMAL;
        cmd_vel_ever_received = false;
        LOG_INF("cmd_vel lost - lap state reset");
      }
    }

    if (zros_sub_update_available(&ctx->sub_actuators_manual)) {
      zros_sub_update(&ctx->sub_actuators_manual);
    }

    if (zros_sub_update_available(&ctx->sub_odom)) {
      zros_sub_update(&ctx->sub_odom);
    }
    // if (zros_sub_update_available(&ctx->sub_pixy_vector)) {
    //   zros_sub_update(&ctx->sub_pixy_vector);
    // }

    // handle modes
    if (ctx->status.arming != synapse_msgs_Status_Arming_ARMING_ARMED) {
      stop(ctx);
      LOG_DBG("not armed, stopped");
    } else if (ctx->status.mode == synapse_msgs_Status_Mode_MODE_MANUAL) {
      LOG_DBG("manual mode");
      ctx->actuators = ctx->actuators_manual;
    } else if (ctx->status.mode == synapse_msgs_Status_Mode_MODE_AUTO) {
      /* Reset lap detection when re-entering AUTO from another mode */
      if (prev_mode != synapse_msgs_Status_Mode_MODE_AUTO) {
        g_initial_position_set = false;
        ctx->state = STATE_NORMAL;
        LOG_INF("AUTO re-entered, lap state reset");
      }
      LOG_DBG("auto mode");
      follow_line(ctx);
    } else {
      LOG_DBG("cmd_vel mode");
      update_cmd_vel(ctx);
    }

    // publish
    zros_pub_update(
        &ctx->pub_actuators); // aici se copiaza valorile de steer si speed in
                              // actuators,in memoria globala zephyr,
    // lucru care trezeste toate nodurile abonate la acest topic

    prev_mode = mode;
  }
}

K_THREAD_DEFINE(b3rb_velocity, MY_STACK_SIZE, b3rb_velocity_entry_point, &g_ctx,
                NULL, NULL, MY_PRIORITY, 0, 1000);

/* vi: ts=4 sw=4 et */
```
