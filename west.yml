## west.yml
```yaml
# Copyright (c) 2023 CogniPilot Foundation
# SPDX-License-Identifier: Apache-2.0

manifest:

  group-filter:
    - +optional

  self:
    west-commands: scripts/west-commands.yml

  remotes:
    - name: zephyrproject-rtos
      url-base: https://github.com/zephyrproject-rtos
    - name: cognipilot
      url-base: https://github.com/CogniPilot
    - name: nxp
      url-base: https://github.com/NXPHoverGames/

  projects:
    - name: zephyr
      remote: cognipilot
      west-commands: scripts/west-commands.yml
      revision: 041076e5961152a3dee7ef6de8dd502ae3269940 # airy 12/28/23
      import:
        - name-allowlist:
          - nanopb
          - mbedtls
          - hal_nxp
          - cmsis
          - ubxlib
    - name: synapse_tinyframe
      remote: nxp
      revision: nxp-cup
      path: modules/lib/synapse_tinyframe
    - name: synapse_protobuf
      remote: nxp
      revision: nxp-cup
      path: modules/lib/synapse_protobuf
    - name: ubxlib
      remote: cognipilot
      path: modules/lib/ubxlib
      revision: 0e8c66196a9366acf70fb7cfa5a2eaec6647e89d # airy 12/04/23
```
